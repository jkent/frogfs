## Kconfig
```kconfig
menu "FrogFS"

choice
	prompt "Log level"
	default FROGFS_LOG_LEVEL_WARN
	help
		This option sets the log level for FrogFS.

config FROGFS_LOG_LEVEL_NONE
	bool "None"

config FROGFS_LOG_LEVEL_ERROR
	bool "Error"

config FROGFS_LOG_LEVEL_WARN
	bool "Warning"

config FROGFS_LOG_LEVEL_INFO
	bool "Info"

config FROGFS_LOG_LEVEL_DEBUG
	bool "Debug"

config FROGFS_LOG_LEVEL_VERBOSE
	bool "Verbose"

endchoice # "Log level"

config FROGFS_MAX_FLAT_DEPTH
	int "Maximum recursion depth for flat directory traversal"
	default 8
	help
		Uses sizeof(uint16_t) * n per open directory. Set to 1 to disable
		flat directory traversal.

config FROGFS_USE_DEFLATE
	bool "Use zlib deflate"
	default y
	help
		If enabled, this will enable support for decompressing files using
		the zlib deflate algorithm.

config FROGFS_USE_HEATSHRINK
	bool "Use heatshrink"
	default y
	help
		If enabled, this will enable support for decompressing files using
		the heatshrink algorithm.

config FROGFS_MAX_PARTITIONS
	int "Max partitions"
	default 1
	help
		This option specifies the number of partitions that can be mounted
		using VFS at the same time.

config FROGFS_VFS_SUPPORT_DIR
	bool "Compile in VFS directory functions"
	default y
	depends on VFS_SUPPORT_DIR
	help
		This includes functions for opendir, readdir, seekdir, telldir, and
		closedir

endmenu
```

## examples/clockwise/sdkconfig.defaults
```kconfig
CONFIG_CWHTTPD_WORKER_STACK_SIZE=8192
CONFIG_FROGFS_OVERLAY_DIR=y
CONFIG_PARTITION_TABLE_CUSTOM=y
CONFIG_PARTITION_TABLE_CUSTOM_FILENAME="partitions.csv"
CONFIG_PARTITION_TABLE_FILENAME="partitions.csv"
```

## examples/httpd/main/Kconfig.projbuild
```kconfig
menu "Example Configuration"

    config ESP_WIFI_SSID
        string "WiFi SSID"
        default "myssid"
        help
            SSID (network name) for the example to connect to.

    config ESP_WIFI_PASSWORD
        string "WiFi Password"
        default "mypassword"
        help
            WiFi password (WPA or WPA2) for the example to use.

    config ESP_HTTPD_CONN_CLOSE_HEADER
        bool "Send connection close header from request handlers"
        default y
        help
            If this config item is set, Connection: close header will be set in handlers.
            This closes HTTP connection and frees the server socket instantly.
endmenu
```

## examples/httpd/sdkconfig.defaults
```kconfig
CONFIG_PARTITION_TABLE_CUSTOM=y
CONFIG_PARTITION_TABLE_CUSTOM_FILENAME="partitions.csv"
CONFIG_PARTITION_TABLE_FILENAME="partitions.csv"
CONFIG_HTTPD_MAX_REQ_HDR_LEN=1024
```
